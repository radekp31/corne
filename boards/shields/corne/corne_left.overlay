#include "corne.dtsi"

&kscan0 {
    col-gpios
        = <&gpio0 20 GPIO_ACTIVE_HIGH>
        , <&gpio0 13 GPIO_ACTIVE_HIGH>
        , <&gpio0 24 GPIO_ACTIVE_HIGH>
        , <&gpio0 9 GPIO_ACTIVE_HIGH>
        , <&gpio0 10 GPIO_ACTIVE_HIGH>
        , <&gpio1 0 GPIO_ACTIVE_HIGH>
        ;
};

/ {
    chosen {
        zmk,backlight = &backlight;
    };
};
